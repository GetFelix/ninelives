## scripts/tests/fixtures/kernel/source/Kconfig
```kconfig
config MODULES
	bool "Modules"
menuconfig SECURITY
	bool "Security"
config LSM
	string "LSMs"
config IO_URING
	bool "io_uring"
config STRICT_KERNEL_RWX
	bool
config STRICT_MODULE_RWX
	bool
config PROC_KCORE
	bool
```

## scripts/tests/fixtures/kernel/source/arch/x86/Kconfig
```kconfig
config MITIGATION_RETPOLINE
	bool "retpoline"
config IA32_EMULATION
	bool "ia32"
config X86_KERNEL_IBT
	bool "ibt"
```
